.globalzp sp
.globalzp sreg
.globalzp regsave
.globalzp tmp1
.globalzp tmp2
.globalzp tmp3
.globalzp tmp4
.globalzp ptr1
.globalzp ptr2
.globalzp ptr3
.globalzp ptr4
.globalzp lcd_temp_char1
.globalzp lcd_temp_char2
.globalzp lcd_temp_char3
.globalzp acia_rx_rptr
.globalzp acia_rx_wptr
.globalzp acia_tx_rptr
.globalzp acia_tx_wptr
.globalzp keyboard_conn
.globalzp keyboard_rptr
.globalzp keyboard_wptr
.globalzp tty_config
.globalzp system_break_flag
.globalzp system_break_address
.globalzp system_break_sp
.globalzp user_break_address
.globalzp user_break_sp
.globalzp user_irq_address
.globalzp vdp_scratch
.globalzp vdp_buffer_address 
.globalzp vdp_vram_address
.globalzp vdp_char_count
.globalzp sn76489_freq_lsn
.globalzp sn76489_freq_msb
.globalzp midi_tick_countdown
.globalzp next_midi_event

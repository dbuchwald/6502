
;
; Tone Generators 
; All except Freq are single byte writes with embedded register address
; Freq writes have a second write for the 'high' bits of the addr
;
SN76489_T1_FREQ = $80
SN76489_FREQ_H6 = $00
SN76489_T1_ATTN = $90

SN76489_T2_FREQ = $A0
SN76489_T2_ATTN = $B0

SN76489_T3_FREQ = $C0
SN76489_T3_ATTN = $D0

;
; Attenuation Bits
; Same for Tone and Noise Generators
;
SN76489_ATTEN_MASK = $0F
SN76489_ATTEN_0DB  = $00
SN76489_ATTEN_2DB  = $01
SN76489_ATTEN_4DB  = $02
SN76489_ATTEN_8DB  = $04
SN76489_ATTEN_16DB = $08
SN76489_ATTEN_OFF  = $0F


;
; Noise Generator
;
SN76489_NOISE_CTRL = $E0
SN76489_NOISE_ATTN = $F0

;
; Noise Control
;
SN76489_NOISE_PERIODIC  = $00
SN76489_NOISE_WHITE     = $40

; Noise Freq Control
SN76489_NOISE_SHIFT_H = $00
SN76489_NOISE_SHIFT_M = $01
SN76489_NOISE_SHIFT_L = $02
SN76489_NOISE_FREQ_T3 = $03 


      .segment "RODATA"
;
; Basic Notes for 3.579545MHz clock
; There's lots of quantization error, esp. at higher freq
;
NOTE_A2_H6 = $3F	
NOTE_A2_L4 = $09	
NOTE_AS2_H6 = $3C	
NOTE_AS2_L4 = $00	
NOTE_BF2_H6 = $3C	
NOTE_BF2_L4 = $00	
NOTE_B2_H6 = $38	
NOTE_B2_L4 = $0A	
NOTE_C3_H6 = $35	
NOTE_C3_L4 = $07	
NOTE_CS3_H6 = $32	
NOTE_CS3_L4 = $07	
NOTE_DF3_H6 = $32	
NOTE_DF3_L4 = $07	
NOTE_D3_H6 = $2F	
NOTE_D3_L4 = $0A	
NOTE_DS3_H6 = $2C	
NOTE_DS3_L4 = $0F	
NOTE_EF3_H6 = $2C	
NOTE_EF3_L4 = $0F	
NOTE_E3_H6 = $2A	
NOTE_E3_L4 = $07	
NOTE_F3_H6 = $28	
NOTE_F3_L4 = $01	
NOTE_FS3_H6 = $25	
NOTE_FS3_L4 = $0D	
NOTE_GF3_H6 = $25	
NOTE_GF3_L4 = $0D	
NOTE_G3_H6 = $23	
NOTE_G3_L4 = $0B	
NOTE_AF3_H6 = $21	
NOTE_AF3_L4 = $0B	
NOTE_GS3_H6 = $21	
NOTE_GS3_L4 = $0B	
NOTE_A3_H6 = $1F	
NOTE_A3_L4 = $0C	
NOTE_AS3_H6 = $1E	
NOTE_AS3_L4 = $00	
NOTE_BF3_H6 = $1E	
NOTE_BF3_L4 = $00	
NOTE_B3_H6 = $1C	
NOTE_B3_L4 = $05	
NOTE_C4_H6 = $1A	
NOTE_C4_L4 = $0C	
NOTE_CS4_H6 = $19	
NOTE_CS4_L4 = $04	
NOTE_DF4_H6 = $19	
NOTE_DF4_L4 = $04	
NOTE_D4_H6 = $17	
NOTE_D4_L4 = $0D	
NOTE_DS4_H6 = $16	
NOTE_DS4_L4 = $08	
NOTE_EF4_H6 = $16	
NOTE_EF4_L4 = $08	
NOTE_E4_H6 = $15	
NOTE_E4_L4 = $03	
NOTE_F4_H6 = $14	
NOTE_F4_L4 = $00	
NOTE_FS4_H6 = $12	
NOTE_FS4_L4 = $0E	
NOTE_GF4_H6 = $12	
NOTE_GF4_L4 = $0E	
NOTE_G4_H6 = $11	
NOTE_G4_L4 = $0D	
NOTE_AF4_H6 = $10	
NOTE_AF4_L4 = $0D	
NOTE_GS4_H6 = $10	
NOTE_GS4_L4 = $0D	
NOTE_A4_H6 = $0F	
NOTE_A4_L4 = $0E	
NOTE_AS4_H6 = $0F	
NOTE_AS4_L4 = $00	
NOTE_BF4_H6 = $0F	
NOTE_BF4_L4 = $00	
NOTE_B4_H6 = $0E	
NOTE_B4_L4 = $02	
NOTE_C5_H6 = $0D	
NOTE_C5_L4 = $06	
NOTE_CS5_H6 = $0C	
NOTE_CS5_L4 = $0A	
NOTE_DF5_H6 = $0C	
NOTE_DF5_L4 = $0A	
NOTE_D5_H6 = $0B	
NOTE_D5_L4 = $0E	
NOTE_DS5_H6 = $0B	
NOTE_DS5_L4 = $04	
NOTE_EF5_H6 = $0B	
NOTE_EF5_L4 = $04	
NOTE_E5_H6 = $0A	
NOTE_E5_L4 = $0A	
NOTE_F5_H6 = $0A	
NOTE_F5_L4 = $00	
NOTE_FS5_H6 = $09	
NOTE_FS5_L4 = $07	
NOTE_GF5_H6 = $09	
NOTE_GF5_L4 = $07	
NOTE_G5_H6 = $08	
NOTE_G5_L4 = $0F	
NOTE_AF5_H6 = $08	
NOTE_AF5_L4 = $07	
NOTE_GS5_H6 = $08	
NOTE_GS5_L4 = $07	
NOTE_A5_H6 = $07	
NOTE_A5_L4 = $0F	
NOTE_AS5_H6 = $07	
NOTE_AS5_L4 = $08	
NOTE_BF5_H6 = $07	
NOTE_BF5_L4 = $08	
NOTE_B5_H6 = $07	
NOTE_B5_L4 = $01	
NOTE_C6_H6 = $06	
NOTE_C6_L4 = $0B	
NOTE_CS6_H6 = $06	
NOTE_CS6_L4 = $05	
NOTE_DF6_H6 = $06	
NOTE_DF6_L4 = $05	
NOTE_D6_H6 = $05	
NOTE_D6_L4 = $0F	
NOTE_DS6_H6 = $05	
NOTE_DS6_L4 = $0A	
NOTE_EF6_H6 = $05	
NOTE_EF6_L4 = $0A	
NOTE_E6_H6 = $05	
NOTE_E6_L4 = $05	
NOTE_F6_H6 = $05	
NOTE_F6_L4 = $00	
NOTE_FS6_H6 = $04	
NOTE_FS6_L4 = $0C	
NOTE_GF6_H6 = $04	
NOTE_GF6_L4 = $0C	
NOTE_G6_H6 = $04	
NOTE_G6_L4 = $07	
NOTE_AF6_H6 = $04	
NOTE_AF6_L4 = $03	
NOTE_GS6_H6 = $04	
NOTE_GS6_L4 = $03	
NOTE_A6_H6 = $04	
NOTE_A6_L4 = $00	
NOTE_AS6_H6 = $03	
NOTE_AS6_L4 = $0C	
NOTE_BF6_H6 = $03	
NOTE_BF6_L4 = $0C	
NOTE_B6_H6 = $03	
NOTE_B6_L4 = $09	
NOTE_C7_H6 = $03	
NOTE_C7_L4 = $05	
NOTE_CS7_H6 = $03	
NOTE_CS7_L4 = $02	
NOTE_DF7_H6 = $03	
NOTE_DF7_L4 = $02	
NOTE_D7_H6 = $03	
NOTE_D7_L4 = $00	
NOTE_DS7_H6 = $02	
NOTE_DS7_L4 = $0D	
NOTE_EF7_H6 = $02	
NOTE_EF7_L4 = $0D	
NOTE_E7_H6 = $02	
NOTE_E7_L4 = $0A	
NOTE_F7_H6 = $02	
NOTE_F7_L4 = $08	
NOTE_FS7_H6 = $02	
NOTE_FS7_L4 = $06	
NOTE_GF7_H6 = $02	
NOTE_GF7_L4 = $06	
NOTE_G7_H6 = $02	
NOTE_G7_L4 = $04	
NOTE_AF7_H6 = $02	
NOTE_AF7_L4 = $02	
NOTE_GS7_H6 = $02	
NOTE_GS7_L4 = $02	
NOTE_A7_H6 = $02	
NOTE_A7_L4 = $00	
NOTE_AS7_H6 = $01	
NOTE_AS7_L4 = $0E	
NOTE_BF7_H6 = $01	
NOTE_BF7_L4 = $0E	
NOTE_B7_H6 = $01	
NOTE_B7_L4 = $0C	
NOTE_C8_H6 = $01	
NOTE_C8_L4 = $0B	

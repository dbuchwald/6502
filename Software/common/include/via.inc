      .import VIA1_PORTB
      .import VIA1_PORTA
      .import VIA1_DDRB
      .import VIA1_DDRA
      .import VIA1_T1CL
      .import VIA1_T1CH
      .import VIA1_T1LL
      .import VIA1_T1LH
      .import VIA1_T2CL
      .import VIA1_T2CH
      .import VIA1_SR
      .import VIA1_ACR
      .import VIA1_PCR
      .import VIA1_IFR
      .import VIA1_IER
      .import VIA1_PANH

      .import VIA2_PORTB
      .import VIA2_PORTA
      .import VIA2_DDRB
      .import VIA2_DDRA
      .import VIA2_T1CL
      .import VIA2_T1CH
      .import VIA2_T1LL
      .import VIA2_T1LH
      .import VIA2_T2CL
      .import VIA2_T2CH
      .import VIA2_SR
      .import VIA2_ACR
      .import VIA2_PCR
      .import VIA2_IFR
      .import VIA2_IER
      .import VIA2_PANH




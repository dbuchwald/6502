;
; Memory Mapped Registers
;
VDP_REGISTER_OFFSET = $01
VDP_REGISTER_SELECT = $80
VDP_REGISTER_MASK   = $03

VDP_VRAM_OFFSET = $00
VDP_READ_VRAM_SELECT   = $00
VDP_WRITE_VRAM_SELECT  = $40
VDP_VRAM_MSB_MASK = $3F

;
; Internal Registers
;

;
; Register 0 
;
VDP_REG0_MODE_BIT_M3_ENABLE   = %0000010
VDP_REG0_MODE_BIT_M3_DISABLE  = %0000000
VDP_REG1_EXTERNAL_VDP_ENABLE  = %00000001
VDP_REG1_EXTERNAL_VDP_DISABLE = %00000000

VDP_REG_0_GRAPHICS_MODE_II_ENABLE = %00000010
VDP_REG_0_GRAPHICS_MODE_II_DISABLE = %00000000

;
; Register 1
;
VDP_REGISTER_1 = $01

VDP_REG1_RAM_4K  = %00000000  
VDP_REG1_RAM_16K = %10000000

VDP_REG1_SCREEN_BLANK = %00000000
VDP_REG1_SCREEN_ACTIVE = %01000000

VDP_REG1_INTERRUPT_ENABLE = %00100000
VDP_REG1_INTERRUPT_DISABLE = %00000000

VDP_REG1_MODE_BIT_M1_ENABLE = %00010000
VDP_REG1_MODE_BIT_M1_DISABLE = %00000000

VDP_REG1_MODE_BIT_M2_ENABLE = %00001000
VDP_REG1_MODE_BIT_M2_DISABLE = %00000000

VDP_REG_1_SPRITE_SIZE_8x8 = %00000000
VDP_REG_1_SPRITE_SIZE_16x16 = %00000010

VDP_REG_1_SPRITE_MAG_1X = %00000000
VDP_REG_1_SPRITE_MAG_2X = %00000001

VDP_REG1_GRAPHICS_MODE_II_ENABLE = VDP_REG1_MODE_BIT_M1_DISABLE | VDP_REG1_MODE_BIT_M2_DISABLE
VDP_REG1_GRAPHICS_MODE_I_ENABLE = VDP_REG1_MODE_BIT_M1_DISABLE | VDP_REG1_MODE_BIT_M2_DISABLE
VDP_REG1_MULTICOLOR_MODE_ENABLE = VDP_REG1_MODE_BIT_M1_DISABLE | VDP_REG1_MODE_BIT_M2_ENABLE
VDP_REG1_TEXT_MODE_ENABLE = VDP_REG1_MODE_BIT_M1_ENABLE | VDP_REG1_MODE_BIT_M2_DISABLE

;
; Register 2 - Name Table (Screen Map)
; Name Table Base Address
;
VDP_REG2_NAME_TABLE_BASE_0000 = $00
VDP_REG2_NAME_TABLE_BASE_0400 = $01
VDP_REG2_NAME_TABLE_BASE_0800 = $02
VDP_REG2_NAME_TABLE_BASE_0C00 = $03

VDP_REG2_NAME_TABLE_BASE_1000 = $04
VDP_REG2_NAME_TABLE_BASE_1400 = $05
VDP_REG2_NAME_TABLE_BASE_1800 = $06
VDP_REG2_NAME_TABLE_BASE_1C00 = $07

VDP_REG2_NAME_TABLE_BASE_2000 = $08
VDP_REG2_NAME_TABLE_BASE_2400 = $09
VDP_REG2_NAME_TABLE_BASE_2800 = $0A
VDP_REG2_NAME_TABLE_BASE_2C00 = $0B

VDP_REG2_NAME_TABLE_BASE_3000 = $0C
VDP_REG2_NAME_TABLE_BASE_3400 = $0D
VDP_REG2_NAME_TABLE_BASE_3800 = $0E
VDP_REG2_NAME_TABLE_BASE_3C00 = $0F


;
; Register 3 - Color Table
; Color Table Base Address
; Addr = R3 * $40
;
VDP_REG3_COLOR_TABLE_BASE_0000 = $00
VDP_REG3_COLOR_TABLE_BASE_0001 = $40
;...
VDP_REG3_COLOR_TABLE_BASE_0D00 = $34
;...

;
; Register 4 - Pattern Tables
; Pattern / Text / Multicolor 
; Generator Table Base Address Select
; Addr = R4 * $800
;
VDP_REG4_PATTERN_TABLE_BASE_0000 = $00
VDP_REG4_PATTERN_TABLE_BASE_0800 = $01
VDP_REG4_PATTERN_TABLE_BASE_1000 = $02
VDP_REG4_PATTERN_TABLE_BASE_1800 = $03

VDP_REG4_PATTERN_TABLE_BASE_2000 = $04
VDP_REG4_PATTERN_TABLE_BASE_2800 = $05
VDP_REG4_PATTERN_TABLE_BASE_3000 = $06
VDP_REG4_PATTERN_TABLE_BASE_3800 = $07

;
; Register 5 - Sprite Attribute
; Sprite Attribute Table Base Address Select
; Addr = R5 * $80
;
VDP_REG5_SPRITE_ATTRIBUTE_TABLE_BASE_0000 = $00
VDP_REG5_SPRITE_ATTRIBUTE_TABLE_BASE_0080 = $01
VDP_REG5_SPRITE_ATTRIBUTE_TABLE_BASE_0100 = $02

;
; Register 6 - Sprite Pattern
; Sprite Pattern Generate Table Base Address Select
; Addr = R6 * $800
;
VDP_REG6_SPRITE_PATTERN_TABLE_BASE_0000 = $00
VDP_REG6_SPRITE_PATTERN_TABLE_BASE_0800 = $01
VDP_REG6_SPRITE_PATTERN_TABLE_BASE_1000 = $02
VDP_REG6_SPRITE_PATTERN_TABLE_BASE_1800 = $03

VDP_REG6_SPRITE_PATTERN_TABLE_BASE_2000 = $04
VDP_REG6_SPRITE_PATTERN_TABLE_BASE_2800 = $05
VDP_REG6_SPRITE_PATTERN_TABLE_BASE_3000 = $06
VDP_REG6_SPRITE_PATTERN_TABLE_BASE_3800 = $07


;
; Register 7 - Background / Text  Color
;
VDP_REG7_FOREGROUND_COLOR_MASK = %11110000
VDP_REG7_BACKGROUND_COLOR_MASK = %00001111


;
; Status Register
;
VDP_STATUS_INTERRUPT_ACTIVE_FLAG = %10000000
VDP_STATUS_SPRITE_COINCIDENCE_FLAG = %00100000
VDP_STATUS_SPRITE_5S_FLAG = %01000000
VDP_STATUS_5TH_SPRITE_MASK = %00011111


;
; Colors
;
VDP_COLOR_MASK_LOW_NIBBLE  = %00001111
VDP_COLOR_MASK_HIGH_NIBBLE = %11110000

VDP_COLOR_TRANSPARENT   = $00
VDP_COLOR_BLACK         = $11
VDP_COLOR_MEDIUM_GREEN  = $22
VDP_COLOR_LIGHT_GREEN   = $33

VDP_COLOR_DARK_BLUE     = $44
VDP_COLOR_LIGHT_BLUE    = $55
VDP_COLOR_DARK_RED      = $66
VDP_COLOR_CYAN          = $77

VDP_COLOR_MEDIUM_RED    = $88
VDP_COLOR_LIGHT_RED     = $99
VDP_COLOR_DARK_YELLOW   = $AA
VDP_COLOR_LIGHT_YELLOW  = $BB

VDP_COLOR_DARK_GREEN    = $CC
VDP_COLOR_MAGENTA       = $DD
VDP_COLOR_GRAY          = $EE
VDP_COLOR_WHITE         = $FF




